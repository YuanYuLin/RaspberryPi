## package/advancemame/Config.in
```kconfig
config BR2_PACKAGE_ADVANCEMAME
        bool "AdvanceMAME"
        depends on BR2_PACKAGE_ALSA_LIB
        help
          This will install the advancemame emulator.
```

## package/dfreerdp/Config.in
```kconfig
config BR2_PACKAGE_DFREERDP
	bool "dfreerdp"
	select BR2_PACKAGE_OPENSSL
	select BR2_PACKAGE_ZLIB
	depends on BR2_PACKAGE_DIRECTFB
	help
	  FreeRDP is a free implementation of the Remote Desktop
	  Protocol (RDP), released under the Apache license
          It runs on DirectFB.

	  http://www.freerdp.com/
```

## package/omxplayer/Config.in
```kconfig
config BR2_PACKAGE_OMXPLAYER
        bool "oMxPlayer"
        depends on BR2_PACKAGE_FFMPEG
        help
          This will install the oMxPlayer for Raspberry PI.
```
